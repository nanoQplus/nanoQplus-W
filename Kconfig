## Kconfig
```kconfig
source "nos/kernel/Kconfig"
#source "nos/net/Kconfig"
source "nos/lib/Kconfig"
source "support/storage/Kconfig"
```

## nos/arch/stm32f40x/Kconfig
```kconfig
config MCU_NAME
	string
	default "stm32f40x"

choice
	prompt "Toolchain"
	default GCC_TOOLCHAIN
	config GCC_TOOLCHAIN
		bool "GCC"

endchoice
	
```

## nos/kernel/Kconfig
```kconfig
# $LastChangedDate$
# $Id$

# For a description of the syntax of this configuration file,
# see doc/kbuild/kconfig-language.txt.

menu "Kernel"

	config KERNEL_M
		bool "Task Scheduler"
		default n
		help
		Kernel Module

	choice
		prompt "Time-Slice for Scheduling (Resolution for User Timer)"
		depends on KERNEL_M
		default SCHED_PERIOD_10
		config SCHED_PERIOD_10
			bool "10ms"
		config SCHED_PERIOD_32
			bool "32ms"
		config SCHED_PERIOD_100
			bool "100ms"
	endchoice

#	config SCHED_TIMER_MS
#		depends on ENABLE_SCHEDULING
#		int
#		prompt "Time Slice (ms)"
#		range 5 1000
#		default 10

	choice
		prompt "Task queue length"
		depends on KERNEL_M
		default TASKQ_LEN_32
		config TASKQ_LEN_8
			bool "8"
		config TASKQ_LEN_16
			bool "16"
		config TASKQ_LEN_32
			bool "32"
		config TASKQ_LEN_64
			bool "64"
		config TASKQ_LEN_128
			bool "128"
	endchoice

	config USER_TIMER_M
		bool "User Timer"
		depends on KERNEL_M
		default y

	config THREAD_M
		bool "Multi-thread support"
		depends on KERNEL_M
		default y
		help
		Supports up to 5 user threads.

	config ENABLE_SCHEDULING
		bool "Periodic Scheduling (Automatically by Hardware Timer)"
		depends on THREAD_M
		default y

	config THREAD_EXT_M
		bool "Thread Extension"
		depends on THREAD_M
		default n
		help
		Supports up to 15 threads. This may lower the performace.

	config SEM_M
		bool "Semaphore"
		depends on THREAD_M
		default n 

	config MSGQ_M
		bool "Message Queue"
		depends on THREAD_M
		default n



endmenu
```

## nos/lib/Kconfig
```kconfig
menu "Debugging"

	config NOS_DEBUG_M
		bool "Debugging via STDIO"
		default n
		depends on UART_M

#	config NOS_STACK_DEBUG_M
#		bool "Print stack usage whenever STACK grows."
#		default n
#		depends on UART_M
#		help
#		Print the lowest STACK pointer (Maximum use of STACK)

	config HEAP_DEBUG
		bool "Heap debug"
		default n
		depends on UART_M

endmenu
```

## nos/platform/stm32f4_discovery/Kconfig
```kconfig
source "nos/arch/stm32f40x/Kconfig"
#	help
#	STM32F407VG (Flash: 1024KB, RAM: 192KB)

menu "Platform: STM32F4 Discovery Kit"
	config PLATFORM_NAME
		string
		default "stm32f4_discovery"
		help
		PLATFORM_NAME MUST be the same as "directory name"

	menuconfig UART_M
		bool "UART"
		default y

		choice
			prompt "UART1"
			depends on UART_M
			default UART1_STDIO

			config UART1_STDIO
				bool "Standard I/O"
				select UART1
			config UART1_SLIPIO
				bool "SLIP I/O"
				select UART1
			config UART1_DISABLED
				bool "Disable"
		endchoice

		config UART1
			bool
			default y
			depends on UART_M
			
		config UART1_BAUDRATE
			prompt "UART1 Baud rate (Default:115200, Max:4500000)"
			int 
			default "115200"
			depends on UART1

		choice
			prompt "UART2"
			depends on UART_M 
			default UART2_DISABLED

			config UART2_STDIO
				bool "Standard I/O"
				select UART2
			config UART2_SLIPIO
				bool "SLIP I/O"
				select UART2
			config UART2_DISABLED
				bool "Disable"
		endchoice

		config UART2
			bool
			default n
			depends on UART_M
			
		config UART2_BAUDRATE
			prompt "UART2 Baud rate (Default:115200, Max:2250000)"
			int 
			default "115200"
			depends on UART2
	
	config LED_M
		bool "LED"
		default y
	
	config BUTTON_M
		bool "Button"
		default y

	config NAND_M
		bool "Nand Flash (K9F1G08U0D, 128MB)"
		default y

	config PWM_M
		bool "Power Management"
		default y
endmenu

source "Kconfig"
```

## support/storage/Kconfig
```kconfig
menu "Storage"

	config CFD_M
		bool "Common Flash Driver"
		default n

	config SSL_M
		bool "Snapshot Support Layer"
		default n
		depends on CFD_M

	config FTL_M
		bool "Flash Translation Layer"
		default n
		depends on CFD_M

	config LPFS_M
		bool "Low-Power File System"
		default n
		depends on FTL_M

endmenu
```
